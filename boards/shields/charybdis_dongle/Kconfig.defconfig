## boards/shields/charybdis_dongle/Kconfig.defconfig
```kconfig
if SHIELD_CHARYBDIS_DONGLE

config ZMK_KEYBOARD_NAME
	default "Charybdis"

config ZMK_SPLIT_ROLE_CENTRAL
	default y

config CHARYBDIS_DONGLE_STATUS_SCREEN
	bool "Charybdis dongle display status screen"
	depends on ZMK_DISPLAY_STATUS_SCREEN_CUSTOM
	select LV_OBJ_LABEL
	select LV_USE_LABEL
	select LV_FONT_MONTSERRAT_12
	select LV_FONT_MONTSERRAT_16
	default n

endif

if SHIELD_CHARYBDIS_LEFT || SHIELD_CHARYBDIS_RIGHT || SHIELD_CHARYBDIS_DONGLE

config ZMK_SPLIT
	default y
	
endif

if SHIELD_CHARYBDIS_DONGLE

if ZMK_DISPLAY

config I2C
	default y

config SSD1306
	default y

choice ZMK_DISPLAY_WORK_QUEUE
	default ZMK_DISPLAY_WORK_QUEUE_DEDICATED
endchoice

endif # ZMK_DISPLAY

if LVGL

config LV_Z_VDB_SIZE
	default 64

config LV_DPI_DEF
	default 148

config LV_Z_BITS_PER_PIXEL
	default 1

choice LV_COLOR_DEPTH
	default LV_COLOR_DEPTH_1
endchoice

endif # LVGL

endif # SHIELD_CHARYBDIS_DONGLE
```

## config/Kconfig
```kconfig
config ZMK_INPUT_PROCESSOR_CARET
    bool "Trackball-to-caret input processor"
    default y
    depends on ZMK_POINTING
    help
      Convert relative X/Y input movement into discrete arrow-key taps.
```

## config/dts/bindings/input_processors/zmk,input-processor-caret.yaml
```yaml
# Copyright (c) 2026
# SPDX-License-Identifier: MIT

description: Convert relative X/Y movement into directional behavior taps

compatible: "zmk,input-processor-caret"

include: ip_zero_param.yaml

properties:
  threshold:
    type: int
    required: true
    description: Absolute accumulated movement required for one behavior tap

  bindings:
    type: phandle-array
    required: true
    description: Behaviors for left, right, up, and down, in that order
```

## config/west.yml
```yaml
manifest:
  remotes:
    - name: zmkfirmware
      url-base: https://github.com/zmkfirmware

    - name: 280Zo
      url-base: https://github.com/280Zo

    - name: englmaxi
      url-base: https://github.com/englmaxi

  projects:
    - name: zmk
      remote: zmkfirmware
      revision: main
      import: app/west.yml

    - name: zmk-pmw3610-driver
      remote: 280Zo
      revision: main

    - name: zmk-dongle-display
      remote: englmaxi
      revision: main

  self:
    path: config
```
